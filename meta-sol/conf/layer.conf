## meta-sol/conf/layer.conf
```bitbake
BBPATH .= ":${LAYERDIR}"
BBFILES += "${LAYERDIR}/recipes*/*/*.bb ${LAYERDIR}/recipes*/*/*.bbappend"
BBFILE_COLLECTIONS += "sol-hybris-layer"
BBFILE_PATTERN_sol-hybris-layer := "^${LAYERDIR}/"
BBFILE_PRIORITY_sol-hybris-layer = "8"
LAYERSERIES_COMPAT_sol-hybris-layer = "walnascar"
```
